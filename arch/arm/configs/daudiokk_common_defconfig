## arch/arm/configs/daudiokk_common_defconfig
```kconfig
CONFIG_CROSS_COMPILE="arm-eabi-"
CONFIG_LOCALVERSION="-tcc"
# CONFIG_LOCALVERSION_AUTO is not set
CONFIG_SYSVIPC=y
CONFIG_AUDIT=y
CONFIG_NO_HZ=y
CONFIG_HIGH_RES_TIMERS=y
CONFIG_IKCONFIG=y
# CONFIG_IKCONFIG_PROC is not set
CONFIG_CGROUPS=y
CONFIG_CGROUP_DEBUG=y
CONFIG_CGROUP_FREEZER=y
CONFIG_CGROUP_CPUACCT=y
CONFIG_RESOURCE_COUNTERS=y
CONFIG_CGROUP_SCHED=y
CONFIG_RT_GROUP_SCHED=y
CONFIG_BLK_DEV_INITRD=y
CONFIG_KALLSYMS_ALL=y
CONFIG_EMBEDDED=y
# CONFIG_SLUB_DEBUG is not set
CONFIG_MODULES=y
CONFIG_MODULE_UNLOAD=y
CONFIG_MODULE_FORCE_UNLOAD=y
# CONFIG_BLK_DEV_BSG is not set
CONFIG_PARTITION_ADVANCED=y
# CONFIG_IOSCHED_DEADLINE is not set
# CONFIG_IOSCHED_CFQ is not set
CONFIG_ARCH_TCC=y
CONFIG_ARCH_TCC897X=y
CONFIG_DAUDIO=y
CONFIG_DAUDIO_KK=y
CONFIG_PLATFORM_AVN=y
CONFIG_ARM_THUMBEE=y
CONFIG_SMP=y
CONFIG_SCHED_MC=y
CONFIG_NR_CPUS=8
CONFIG_PREEMPT=y
CONFIG_HIGHMEM=y
CONFIG_KSM=y
CONFIG_DEFAULT_MMAP_MIN_ADDR=32768
CONFIG_ARM_APPENDED_DTB=y
CONFIG_ARM_ATAG_DTB_COMPAT=y
CONFIG_ARM_ATAG_DTB_COMPAT_CMDLINE_EXTEND=y
CONFIG_CMDLINE="vmalloc=480M"
CONFIG_CMDLINE_EXTEND=y
# CONFIG_CPU_FREQ is not set
# CONFIG_CPU_FREQ_DEFAULT_GOV_PERFORMANCE is not set
# CONFIG_CPU_FREQ_GOV_PERFORMANCE is not set
# CONFIG_CPU_FREQ_GOV_ONDEMAND is not set
# CONFIG_CPU_FREQ_GOV_INTERACTIVE is not set
CONFIG_CPU_IDLE=y
# CONFIG_CORE_DUMP_DEFAULT_ELF_HEADERS is not set
#CONFIG_HIBERNATION=y
#CONFIG_SNAPSHOT_BOOT=y
CONFIG_PM_AUTOSLEEP=y
CONFIG_PM_WAKELOCKS=y
# CONFIG_PM_RUNTIME is not set
CONFIG_NET=y
CONFIG_PACKET=y
CONFIG_UNIX=y
CONFIG_XFRM_USER=y
CONFIG_NET_KEY=y
CONFIG_INET=y
CONFIG_IP_MULTICAST=y
CONFIG_IP_ADVANCED_ROUTER=y
CONFIG_IP_MULTIPLE_TABLES=y
CONFIG_IP_ROUTE_VERBOSE=y
CONFIG_IP_PNP=y
CONFIG_IP_PNP_DHCP=y
CONFIG_INET_AH=y
CONFIG_INET_ESP=y
CONFIG_INET_IPCOMP=y
# CONFIG_INET_LRO is not set
CONFIG_IPV6=y
CONFIG_IPV6_ROUTER_PREF=y
CONFIG_IPV6_ROUTE_INFO=y
CONFIG_IPV6_OPTIMISTIC_DAD=y
CONFIG_INET6_AH=y
CONFIG_INET6_ESP=y
CONFIG_INET6_IPCOMP=y
CONFIG_IPV6_MIP6=y
CONFIG_IPV6_TUNNEL=y
CONFIG_IPV6_MULTIPLE_TABLES=y
CONFIG_IPV6_SUBTREES=y
CONFIG_NETFILTER=y
CONFIG_NF_CONNTRACK=y
CONFIG_NF_CONNTRACK_SECMARK=y
CONFIG_NF_CONNTRACK_EVENTS=y
CONFIG_NF_CT_PROTO_DCCP=y
CONFIG_NF_CT_PROTO_SCTP=y
CONFIG_NF_CT_PROTO_UDPLITE=y
CONFIG_NF_CONNTRACK_AMANDA=y
CONFIG_NF_CONNTRACK_FTP=y
CONFIG_NF_CONNTRACK_H323=y
CONFIG_NF_CONNTRACK_IRC=y
CONFIG_NF_CONNTRACK_NETBIOS_NS=y
CONFIG_NF_CONNTRACK_PPTP=y
CONFIG_NF_CONNTRACK_SANE=y
CONFIG_NF_CONNTRACK_TFTP=y
CONFIG_NF_CT_NETLINK=y
CONFIG_NETFILTER_XT_TARGET_CLASSIFY=y
CONFIG_NETFILTER_XT_TARGET_CONNMARK=y
CONFIG_NETFILTER_XT_TARGET_CONNSECMARK=y
CONFIG_NETFILTER_XT_TARGET_IDLETIMER=y
CONFIG_NETFILTER_XT_TARGET_LOG=y
CONFIG_NETFILTER_XT_TARGET_MARK=y
CONFIG_NETFILTER_XT_TARGET_NFLOG=y
CONFIG_NETFILTER_XT_TARGET_NFQUEUE=y
CONFIG_NETFILTER_XT_TARGET_TPROXY=y
CONFIG_NETFILTER_XT_TARGET_TRACE=y
CONFIG_NETFILTER_XT_TARGET_SECMARK=y
CONFIG_NETFILTER_XT_TARGET_TCPMSS=y
CONFIG_NETFILTER_XT_MATCH_COMMENT=y
CONFIG_NETFILTER_XT_MATCH_CONNBYTES=y
CONFIG_NETFILTER_XT_MATCH_CONNLIMIT=y
CONFIG_NETFILTER_XT_MATCH_CONNMARK=y
CONFIG_NETFILTER_XT_MATCH_CONNTRACK=y
CONFIG_NETFILTER_XT_MATCH_HASHLIMIT=y
CONFIG_NETFILTER_XT_MATCH_HELPER=y
CONFIG_NETFILTER_XT_MATCH_IPRANGE=y
CONFIG_NETFILTER_XT_MATCH_LENGTH=y
CONFIG_NETFILTER_XT_MATCH_LIMIT=y
CONFIG_NETFILTER_XT_MATCH_MAC=y
CONFIG_NETFILTER_XT_MATCH_MARK=y
CONFIG_NETFILTER_XT_MATCH_MULTIPORT=y
CONFIG_NETFILTER_XT_MATCH_POLICY=y
CONFIG_NETFILTER_XT_MATCH_PKTTYPE=y
CONFIG_NETFILTER_XT_MATCH_QTAGUID=y
CONFIG_NETFILTER_XT_MATCH_QUOTA=y
CONFIG_NETFILTER_XT_MATCH_QUOTA2=y
CONFIG_NETFILTER_XT_MATCH_SOCKET=y
CONFIG_NETFILTER_XT_MATCH_STATE=y
CONFIG_NETFILTER_XT_MATCH_STATISTIC=y
CONFIG_NETFILTER_XT_MATCH_STRING=y
CONFIG_NETFILTER_XT_MATCH_TIME=y
CONFIG_NETFILTER_XT_MATCH_U32=y
CONFIG_NF_CONNTRACK_IPV4=y
CONFIG_NF_NAT_IPV4=y
CONFIG_IP_NF_IPTABLES=y
CONFIG_IP_NF_MATCH_AH=y
CONFIG_IP_NF_MATCH_ECN=y
CONFIG_IP_NF_MATCH_TTL=y
CONFIG_IP_NF_FILTER=y
CONFIG_IP_NF_TARGET_REJECT=y
CONFIG_IP_NF_MANGLE=y
CONFIG_IP_NF_RAW=y
CONFIG_IP_NF_SECURITY=y
CONFIG_IP_NF_ARPTABLES=y
CONFIG_IP_NF_ARPFILTER=y
CONFIG_IP_NF_ARP_MANGLE=y
CONFIG_IP_NF_NAT=y
CONFIG_IP_NF_TARGET_MASQUERADE=y
CONFIG_IP_NF_TARGET_NETMAP=y
CONFIG_IP_NF_TARGET_REDIRECT=y
CONFIG_NF_CONNTRACK_IPV6=y
CONFIG_NF_NAT_IPV6=y
CONFIG_IP6_NF_IPTABLES=y
CONFIG_IP6_NF_FILTER=y
CONFIG_IP6_NF_TARGET_REJECT=y
CONFIG_IP6_NF_MANGLE=y
CONFIG_IP6_NF_RAW=y
CONFIG_BRIDGE_NF_EBTABLES=y
CONFIG_BRIDGE_EBT_BROUTE=y
CONFIG_L2TP=y
CONFIG_BRIDGE=y
CONFIG_NET_SCHED=y
CONFIG_NET_SCH_HTB=y
CONFIG_NET_SCH_PRIO=y
CONFIG_NET_CLS_FW=y
CONFIG_NET_CLS_U32=y
CONFIG_CLS_U32_MARK=y
CONFIG_NET_CLS_FLOW=y
CONFIG_NET_EMATCH=y
CONFIG_NET_EMATCH_CMP=y
CONFIG_NET_EMATCH_NBYTE=y
CONFIG_NET_EMATCH_U32=y
CONFIG_NET_EMATCH_META=y
CONFIG_NET_EMATCH_TEXT=y
CONFIG_NET_CLS_ACT=y
CONFIG_BT=y
CONFIG_BT_RFCOMM=y
CONFIG_BT_RFCOMM_TTY=y
CONFIG_BT_BNEP=y
CONFIG_BT_HIDP=y
CONFIG_BT_HCIUART=y
CONFIG_BT_HCIUART_H4=y
CONFIG_BT_HCIUART_BCSP=y
CONFIG_BT_HCIUART_ATH3K=y
CONFIG_CFG80211=y
CONFIG_NL80211_TESTMODE=y
CONFIG_CFG80211_WEXT=y
CONFIG_RFKILL=y
# CONFIG_NFC is not set
CONFIG_UEVENT_HELPER_PATH="/sbin/hotplug"
CONFIG_BLK_DEV_LOOP=y
CONFIG_UID_STAT=y
CONFIG_SCSI=y
CONFIG_BLK_DEV_SD=y
CONFIG_CHR_DEV_SG=y
CONFIG_MD=y
CONFIG_BLK_DEV_DM=y
CONFIG_DM_DEBUG=y
CONFIG_DM_CRYPT=y
CONFIG_DM_UEVENT=y
CONFIG_DM_VERITY=y
CONFIG_NETDEVICES=y
CONFIG_DUMMY=y
CONFIG_TUN=y
CONFIG_PHYLIB=y
CONFIG_TCC_LAN8720_PHY=y
CONFIG_TCC_GMAC=y
CONFIG_USB_USBNET=y
CONFIG_PPP=y
CONFIG_PPP_BSDCOMP=y
CONFIG_PPP_DEFLATE=y
CONFIG_PPP_MPPE=y
CONFIG_PPPOLAC=y
CONFIG_PPPOPNS=y
CONFIG_PPP_ASYNC=y
# CONFIG_INPUT_MOUSEDEV is not set
CONFIG_INPUT_EVDEV=y
CONFIG_INPUT_KEYRESET=y
# CONFIG_KEYBOARD_ATKBD is not set
CONFIG_KEYBOARD_GPIO_POLLED=y
# CONFIG_INPUT_MOUSE is not set
CONFIG_INPUT_TOUCHSCREEN=y
# CONFIG_TOUCHSCREEN_TCC_GT813 is not set
# CONFIG_TOUCHSCREEN_ILITEK_AIMVF is not set
# CONFIG_TOUCHSCREEN_VTL_CT36X is not set
# CONFIG_TOUCHSCREEN_TCCTS is not set
CONFIG_TOUCHSCREEN_ATMEL_MXT_336S_AT=y
CONFIG_TOUCHSCREEN_MELFAS_MIT401=y
CONFIG_TOUCHSCREEN_SIW=y
CONFIG_TOUCHSCREEN_SERDES_INIT=y
CONFIG_TOUCHSCREEN_ONEBIN=y
CONFIG_INPUT_MISC=y
CONFIG_INPUT_KEYCHORD=y
CONFIG_INPUT_UINPUT=y
CONFIG_INPUT_GPIO=y
# CONFIG_SERIO is not set
# CONFIG_CONSOLE_TRANSLATIONS is not set
# CONFIG_VT_CONSOLE is not set
# CONFIG_LEGACY_PTYS is not set
# CONFIG_DEVKMEM is not set
CONFIG_DUP_UART=m
CONFIG_SERIAL_TCC=y
CONFIG_SERIAL_TCC_CONSOLE=y
CONFIG_TTY_PRINTK=y
# CONFIG_HW_RANDOM is not set
CONFIG_I2C=y

CONFIG_TCC_VPU_DRV=m
CONFIG_VDEC_CNT_2=y
CONFIG_ENC_NO_SUPPORT=y

CONFIG_I2C_CHARDEV=y
CONFIG_SPI=y
CONFIG_SPI_TCCXXXX_MASTER=y
CONFIG_SPI_TCCXXXX_TSIF_SLAVE=y
CONFIG_SPI_SPIDEV=y
# CONFIG_GPIO_PCA950X is not set
# CONFIG_HWMON is not set
CONFIG_WATCHDOG=y
CONFIG_TCC_WATCHDOG=y
CONFIG_MFD_DA9062=y
CONFIG_REGULATOR=y
CONFIG_REGULATOR_FIXED_VOLTAGE=y
CONFIG_REGULATOR_GPIO=y
# CONFIG_REGULATOR_DA9062 is not set
# CONFIG_REGULATOR_RT5028 is not set
CONFIG_MEDIA_SUPPORT=y
CONFIG_MEDIA_CAMERA_SUPPORT=y
CONFIG_MEDIA_DIGITAL_TV_SUPPORT=y
CONFIG_V4L_PLATFORM_DRIVERS=y
CONFIG_VIDEO_DEV=y
CONFIG_VIDEO_V4L2=y
CONFIG_VIDEO_TCCXXX_V4L_DEVICE=y
# CONFIG_VIDEO_REAR_CAMERA_SUPPORT is not set
CONFIG_VIDEO_V4L_SENSOR=y
CONFIG_VIDEO_TCCXX_ATV=y
CONFIG_VIDEO_ATV_SENSOR=y
# CONFIG_VIDEO_ATV_SENSOR_TVP5150 is not set
# CONFIG_VIDEO_ATV_SENSOR_ADV7182 is not set
CONFIG_VIDEO_ATV_SENSOR_DAUDIO=y
# CONFIG_LVDS_CAMERA is not set
# CONFIG_LVDS_CAMERA_BT601 is not set
# CONFIG_OF_VIOC is not set 
CONFIG_DAUDIO_IE=y
CONFIG_TCC_WDMA=y
CONFIG_DAUDIO_INFO=y
CONFIG_DAUDIO_INFO_CMDLINE=y
CONFIG_MALI400_GPU=y
CONFIG_FB=y
CONFIG_LCD_SELECT=y
CONFIG_LCD_HDMI1920X720=y
# CONFIG_BACKLIGHT_LCD_SUPPORT is not set
# CONFIG_LCD_CLASS_DEVICE is not set
# CONFIG_BACKLIGHT_CLASS_DEVICE is not set
# CONFIG_BACKLIGHT_GENERIC is not set
# CONFIG_BACKLIGHT_TCC is not set
CONFIG_FB_TCC_USE_VSYNC_INTERRUPT=y
# CONFIG_HWCOMPOSER_OVER_1_1_FOR_MID is not set
CONFIG_FB_TCC_OVERLAY=y
CONFIG_TCC_VIDEO_DISPLAY_BY_VSYNC_INT=y
CONFIG_TCC_LCD_VIDEO_DISPLAY_BY_VSYNC_INT=y
CONFIG_VIOC_FIFO_UNDER_RUN_COMPENSATION=y
# CONFIG_LCD_ED090NA is not set
# CONFIG_LCD_AT070TN93 is not set
CONFIG_EXTEND_DISPLAY_DELAY=y
CONFIG_FB_TCC_COMPOSITE=y
CONFIG_USE_DISPLAY_FB_LOCK=y
# CONFIG_TCC_VIOCMG is not set
# CONFIG_VIDEO_TCC_VOUT is not set
# CONFIG_VIDEO_TCC_VIN is not set
CONFIG_SOUND=y
CONFIG_SND=y
# CONFIG_SND_SUPPORT_OLD_API is not set
CONFIG_SND_USB=y
CONFIG_SND_USB_AUDIO=y
CONFIG_SND_SOC=y
CONFIG_SND_SOC_TCC=y
# CONFIG_SND_SOC_TCC_BOARD_WM8731 is not set
CONFIG_SND_SOC_TCC_MULTICHANNEL=y
CONFIG_SND_SOC_TCC_BOARD_DUMMY=y
CONFIG_SND_SOC_TCC_CDIF=y
CONFIG_SND_SOC_DAUDIO_BOARD=y
CONFIG_SND_SOC_DAUDIO_SUPPORT_PCMIF=y
CONFIG_SND_SOC_DAUDIO_CLOCK_CONTROL=y
CONFIG_SND_SOC_DAUDIO_CLOCK_ROLE_SWITCHING=y
CONFIG_SND_SOC_DAUDIO_NOISE_FILTER=y
CONFIG_SND_SOC_DAUDIO_FIFO_CLEAR_DELAY=y
CONFIG_BLK_CDROM_SUPPORT=y
CONFIG_HIDRAW=y
CONFIG_USB=y
CONFIG_USB_ANNOUNCE_NEW_DEVICES=y
CONFIG_USB_EHCI_HCD=y
CONFIG_USB_EHCI_TCC=m
CONFIG_USB_OHCI_HCD=y
CONFIG_USB_OHCI_TCC=m
CONFIG_USB_STORAGE=y
CONFIG_TCC_DWC_OTG=y
CONFIG_TCC_DWC_IRQ_AFFINITY=1
CONFIG_TCC_DWC_OTG_DUAL_FIRST_HOST=y
CONFIG_USB_LIBCOMPOSITE=y
CONFIG_USB_G_ANDROID=y
CONFIG_USB_NET_QMI_WWAN=m
CONFIG_MMC=y
CONFIG_MMC_EMBEDDED_SDIO=y
CONFIG_MMC_PARANOID_SD_INIT=y
CONFIG_MMC_BLOCK_MINORS=16
CONFIG_MMC_TCC_SDHC=y
CONFIG_ENABLE_TCC_MMC_KPANIC=y
CONFIG_NEW_LEDS=y
CONFIG_LEDS_CLASS=y
CONFIG_LEDS_GPIO=y
CONFIG_LEDS_TRIGGERS=y
CONFIG_LEDS_TRIGGER_TIMER=y
CONFIG_LEDS_TRIGGER_HEARTBEAT=y
CONFIG_SWITCH=y
CONFIG_SWITCH_GPIO=y
CONFIG_RTC_CLASS=y
# CONFIG_RTC_INTF_SYSFS is not set
# CONFIG_RTC_INTF_PROC is not set
CONFIG_TCC_CP=y
CONFIG_STAGING=y
CONFIG_ANDROID=y
CONFIG_ANDROID_BINDER_IPC=y
CONFIG_ASHMEM=y
CONFIG_ANDROID_LOGGER=y
CONFIG_ANDROID_TIMED_GPIO=y
CONFIG_ANDROID_LOW_MEMORY_KILLER=y
CONFIG_ANDROID_INTF_ALARM_DEV=y
CONFIG_SYNC=y
CONFIG_SW_SYNC=y
CONFIG_IIO=y
CONFIG_TCC_ADC=y
CONFIG_TCC_ADC_NO_TOUCHSCREEN=y
CONFIG_PWM=y
CONFIG_EXT2_FS=y
CONFIG_EXT2_FS_XATTR=y
CONFIG_EXT2_FS_POSIX_ACL=y
CONFIG_EXT2_FS_SECURITY=y
CONFIG_EXT4_FS=y
CONFIG_EXT4_FS_SECURITY=y
# CONFIG_DNOTIFY is not set
CONFIG_FUSE_FS=y
CONFIG_VFAT_FS=y
CONFIG_TMPFS=y
CONFIG_CONFIGFS_FS=y
CONFIG_NLS_CODEPAGE_437=y
CONFIG_NLS_ASCII=y
CONFIG_NLS_ISO8859_1=y
CONFIG_NLS_UTF8=y
CONFIG_PRINTK_TIME=y
CONFIG_DYNAMIC_DEBUG=y
CONFIG_DEBUG_INFO=y
CONFIG_MAGIC_SYSRQ=y
CONFIG_DEBUG_VM=y
CONFIG_LOCKUP_DETECTOR=y
CONFIG_BOOTPARAM_HARDLOCKUP_PANIC=y
CONFIG_BOOTPARAM_SOFTLOCKUP_PANIC=y
CONFIG_PANIC_TIMEOUT=5
CONFIG_SCHEDSTATS=y
CONFIG_TIMER_STATS=y
# CONFIG_DEBUG_PREEMPT is not set
CONFIG_DEBUG_SPINLOCK=y
CONFIG_ENABLE_DEFAULT_TRACERS=y
# CONFIG_ARM_UNWIND is not set
CONFIG_DEBUG_USER=y
CONFIG_DEBUG_LL=y
CONFIG_EARLY_PRINTK=y
CONFIG_KEYS=y
CONFIG_SECURITY=y
CONFIG_SECURITY_NETWORK=y
CONFIG_SECURITY_SELINUX=y
CONFIG_DEFAULT_SECURITY_DAC=y
CONFIG_CRYPTO_TWOFISH=y
# CONFIG_CRYPTO_ANSI_CPRNG is not set
CONFIG_LZ4_HC_COMPRESS=y
CONFIG_LZ4_DECOMPRESS=y
CONFIG_DAUDIO_PIN_CONTROL=y
CONFIG_UART_DEBUG_BUS_SYSFS=y
CONFIG_ISO9660_FS=y
CONFIG_JOLIET=y
CONFIG_ZISOFS=y
CONFIG_UDF_FS=y
CONFIG_UDF_NLS=y
CONFIG_I2C_DEBUG_BUS_SYSFS=y
CONFIG_SPI_DEBUG_BUS_SYSFS=y
CONFIG_DAUDIO_TTY_NAME_LEGACY=y
CONFIG_TRACER_MAX_TRACE=y
CONFIG_GENERIC_TRACER=y
CONFIG_SCHED_TRACER=y
# CONFIG_BLK_DEV_IO_TRACE is not set

CONFIG_BCMDHD=m

#CONFIG_ADD_FOR_MIRRORLINK
CONFIG_USB_NET_CDC_NCM=y

#CONFIG FOR USB DC LEVEL ADJUSTMENT
CONFIG_DYNAMIC_DC_LEVEL_ADJUSTMENT=y
CONFIG_USB_HS_DC_VOLTAGE_LEVEL=9
CONFIG_MIN_DC_VOLTAGE_LEVEL=3
CONFIG_LK_DEBUG_LOG_BUF=y
CONFIG_VENC_BUFFER_SIZE=21
CONFIG_VENC_CNT_1=y
CONFIG_MOBIS_NVDATA_HANDLER=y
CONFIG_MOBIS_SYSFS=y
CONFIG_SHRINK_MEMORY=y
```

## arch/arm/configs/daudiokk_lgit_4G_9x28_dual_modem_defconfig
```kconfig
CONFIG_USB_ACM=y
CONFIG_USB_SERIAL=y
CONFIG_USB_SERIAL_GENERIC=y
CONFIG_LGIT_MODEM=y
CONFIG_USB_LGIT_MULTI_RMNET=y
```

## arch/arm/plat-tcc/Kconfig
```kconfig
if ARCH_TCC

choice
	prompt "TCC Processor Family"

config ARCH_TCC897X
	bool "TCC897x"
	select AEABI
	select CPU_V7
	select VFP
	select NEON
	select USE_OF
	select ARM_GIC
	select GENERIC_IRQ_CHIP
#	select SPARSE_IRQ
	select ARM_AMBA
	select HAVE_ARM_SCU if SMP
	select HAVE_SMP
	select CLKDEV_LOOKUP
	select CLKSRC_MMIO
	select CLKSRC_OF
	select COMMON_CLK
	select HAVE_ARM_ARCH_TIMER
	select ARCH_HAS_OPP
	select PM_OPP if PM
	select PM_GENERIC_DOMAINS
	select USB_ARCH_HAS_XHCI
	select PINCTRL_TCC
	select USB_ARCH_HAS_EHCI if USB_SUPPORT
	select USB_ARCH_HAS_OHCI if USB_SUPPORT
	select SOC_TCC
	select ARM_ERRATA_814220

config ARCH_TCC898X
	bool "TCC898X"
	select AEABI
	select CPU_V7
	select VFP
	select NEON
	select USE_OF
	select ARM_GIC
	select GENERIC_IRQ_CHIP
	select ARM_AMBA
	select HAVE_ARM_SCU if SMP
	select HAVE_SMP
	select CLKDEV_LOOKUP
	select CLKSRC_MMIO
	select CLKSRC_OF
	select COMMON_CLK
	select HAVE_ARM_ARCH_TIMER
	select ARCH_HAS_OPP
	select PM_OPP if PM
	select PM_GENERIC_DOMAINS
	select PINCTRL_TCC
	select SOC_TCC
        select MIGHT_HAVE_PCI
        select PCI_DOMAINS if PCI

endchoice



endif
```

## drivers/misc/mobis/Kconfig
```kconfig
config MOBIS_NVDATA_HANDLER
	bool "mobis nvdata handle driver"
	default n
	help
		"mobis nvdata handle driver"

config MOBIS_SYSFS
	bool "mobis sysfs driver"
	default n
	help
		"mobis sysfs driver"
```
